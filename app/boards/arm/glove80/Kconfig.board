## app/boards/arm/glove80/Kconfig.board
```kconfig
# nice!nano board configuration

# Copyright (c) 2020 Pete Johanson
# SPDX-License-Identifier: MIT

config BOARD_NRF52840_M2
	bool "nrf52480_m2"
	depends on SOC_NRF52840_QIAA

config BOARD_GLOVE80_LH
	bool "Glove80 LH"
	depends on SOC_NRF52840_QIAA

config BOARD_GLOVE80_RH
	bool "Glove80 RH"
	depends on SOC_NRF52840_QIAA
```

## app/boards/arm/slicemk_ergodox_202202/Kconfig.board
```kconfig
config BOARD_SLICEMK_ERGODOX_202202
	bool "SliceMK ErgoDox 202202"
	depends on SOC_NRF52840_QIAA
```

## app/boards/arm/slicemk_ergodox_202202/Kconfig.defconfig
```kconfig
if BOARD_SLICEMK_ERGODOX_202202

config BOARD
	default "SliceMK ErgoDox 202202"

if USB

config USB_NRFX
	default y

config USB_DEVICE_STACK
	default y

endif # USB

config BT_CTLR
	default BT

endif # BOARD_SLICEMK_ERGODOX_202202
```

## app/boards/arm/slicemk_ergodox_202202/slicemk_ergodox_202202_defconfig
```kconfig
CONFIG_SOC_SERIES_NRF52X=y
CONFIG_SOC_NRF52840_QIAA=y
CONFIG_BOARD_SLICEMK_ERGODOX_202202=y

# Follow DeviceTree partition.
CONFIG_USE_DT_CODE_PARTITION=y

# Build UF2 firmware.
CONFIG_BUILD_OUTPUT_UF2=y

# Enable MPU.
CONFIG_ARM_MPU=y

# Enable hardware stack protection.
CONFIG_HW_STACK_PROTECTION=y

# Enable basic functionality.
CONFIG_ADC=y
CONFIG_GPIO=y

# Allow P0.09 and P0.10 to be used as regular GPIOs.
CONFIG_NFCT_PINS_AS_GPIOS=y

# Use NVS for settings.
CONFIG_MPU_ALLOW_FLASH_WRITE=y
CONFIG_NVS=y
CONFIG_SETTINGS_NVS=y
CONFIG_FLASH=y
CONFIG_FLASH_PAGE_LAYOUT=y
CONFIG_FLASH_MAP=y

# The Adafruit bootloader 0.6.0 and later allocates 10 pages for user data.
CONFIG_SETTINGS_NVS_SECTOR_COUNT=10

# Use maximum Bluetooth transmit power.
CONFIG_BT_CTLR_TX_PWR_PLUS_8=y

# Include support for Coded PHY.
CONFIG_BT_CTLR_PHY_CODED=y

# Enable logging/debugging and use RTT.
CONFIG_LOG=y
CONFIG_LOG_BUFFER_SIZE=8192
CONFIG_DEBUG=y
CONFIG_USE_SEGGER_RTT=y
CONFIG_SEGGER_RTT_BUFFER_SIZE_UP=8192
CONFIG_CONSOLE=y
CONFIG_RTT_CONSOLE=y
CONFIG_ASSERT=y
CONFIG_LOG_PROCESS_THREAD_SLEEP_MS=100

# Bluetooth stack needs to be increased with debugging enabled.
CONFIG_ZMK_BLE_THREAD_STACK_SIZE=1024
```

## app/boards/shields/glove80_dongle/Kconfig.defconfig
```kconfig
if SHIELD_GLOVE80_DONGLE 

config ZMK_BLE
	default y

config ZMK_USB
	default y

config ZMK_KEYBOARD_NAME
	default "glove80 dongle"

endif

if SHIELD_GLOVE80_DONGLE 

config ZMK_SPLIT
	default y

config ZMK_SPLIT_ROLE_CENTRAL
	default y

endif
```

## app/boards/shields/slicemk_ergodox/Kconfig.defconfig
```kconfig
if SHIELD_SLICEMK_ERGODOX_DONGLE || SHIELD_SLICEMK_ERGODOX_LEFTCENTRAL || SHIELD_SLICEMK_ERGODOX_LEFTSINGLE || SHIELD_SLICEMK_ERGODOX_RIGHTCENTRAL || SHIELD_SLICEMK_ERGODOX_RIGHTSINGLE

config ZMK_BLE
	default y

config ZMK_USB
	default y

config ZMK_KEYBOARD_NAME
	default "SliceMK ErgoDox"

endif

if SHIELD_SLICEMK_ERGODOX_DONGLE || SHIELD_SLICEMK_ERGODOX_LEFTCENTRAL || SHIELD_SLICEMK_ERGODOX_RIGHTCENTRAL

config ZMK_SPLIT
	default y

config ZMK_SPLIT_ROLE_CENTRAL
	default y

endif
```
