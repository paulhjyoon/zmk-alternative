/*
 * Copyright (c) 2020 The ZMK Contributors
 *
 * SPDX-License-Identifier: MIT
 */

#include <dt-bindings/zmk/matrix_transform.h>

/ {
    chosen {
        zmk,kscan = &settings_reset_kscan;
    };

    settings_reset_kscan: settings_reset_kscan {
        compatible = "zmk,kscan-mock";
        columns = <1>;
        rows = <0>;

		input-gpios
			= <&gpio1 6 (GPIO_ACTIVE_LOW | GPIO_PULL_UP)>
			;
	};

};
